## Kconfig
```kconfig
# SPDX-License-Identifier: GPL-2.0-only
config SECURITY_ZTLSM
       bool "ZT Linux Security Module"
       depends on SECURITY
       select SECURITYFS
       help
         ZTLSM is a simple Linux Security Module for experimental
	 and research purposes.
```

## Kconfig.diff
```kconfig
diff --git a/security/Kconfig b/security/Kconfig
index 52c9af08ad35..7ac95684ac7b 100644
--- a/security/Kconfig
+++ b/security/Kconfig
@@ -194,6 +194,7 @@ source "security/yama/Kconfig"
 source "security/safesetid/Kconfig"
 source "security/lockdown/Kconfig"
 source "security/landlock/Kconfig"
+source "security/ztlsm/Kconfig"

 source "security/integrity/Kconfig"
```
